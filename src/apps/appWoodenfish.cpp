#include "AppManager.h"

static const uint8_t AppWoodenfish_icon[] = {
    0x00, 0x00, 0x00, 0x00, 0x00, 0x00, 0x00, 0x00, 0x00, 0x00, 0x00, 0x00, 0x00, 0x00, 0x00, 0x00,
    0x00, 0x00, 0x00, 0x00, 0x00, 0xc0, 0xff, 0x00, 0x00, 0xf0, 0x80, 0x03, 0x00, 0x18, 0x00, 0x06,
    0x00, 0x0c, 0x00, 0x0c, 0x00, 0x06, 0x00, 0x18, 0x00, 0x03, 0x00, 0x30, 0x00, 0x01, 0x00, 0x20,
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    0x00, 0x00, 0x00, 0x00, 0x00, 0x00, 0x00, 0x00, 0x00, 0x00, 0x00, 0x00, 0x00, 0x00, 0x00, 0x00};

static const uint8_t Woodenfish1[] = {
    0x00, 0x00, 0x00, 0x00, 0x00, 0x00, 0x00, 0x00, 0x00, 0x00, 0x00, 0x00, 0x00, 0x00, 0x00, 0x00,
    0x00, 0x00, 0x00, 0x00, 0x00, 0x00, 0x00, 0x00, 0x00, 0x00, 0x00, 0x00, 0x00, 0x00, 0x00, 0x00,
    0x00, 0x00, 0x00, 0x00, 0x00, 0x00, 0x00, 0x00, 0x00, 0x00, 0x00, 0x00, 0x00, 0x00, 0x00, 0x00,
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    0x00, 0x00, 0x00, 0x00, 0x00, 0x00, 0x00, 0x00, 0x00, 0x00, 0xfc, 0xff, 0x3f, 0x00, 0x00, 0x00};

static const uint8_t Woodenfish2[] = {
    0x00, 0x00, 0x00, 0x00, 0x00, 0x00, 0x00, 0x00, 0x00, 0x00, 0x00, 0x00, 0x00, 0x00, 0x00, 0x00,
    0x00, 0x00, 0x00, 0x00, 0x00, 0x00, 0x00, 0x00, 0x00, 0x00, 0x00, 0x00, 0x00, 0x00, 0x00, 0x00,
    0x00, 0x00, 0x00, 0x00, 0x00, 0x00, 0x00, 0x00, 0x00, 0x00, 0x00, 0x00, 0x00, 0x00, 0x00, 0x00,
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    0x00, 0x00, 0x00, 0x00, 0x00, 0x00, 0x00, 0x00, 0x00, 0x00, 0xfc, 0xff, 0x3f, 0x00, 0x00, 0x00};

static const uint8_t WoodenfishNull[] = {
    0x00, 0x00, 0x00, 0x00, 0x00, 0x00, 0x00, 0x00, 0x00, 0x00, 0x00, 0x00, 0x00, 0x00, 0x00, 0x00,
    0x00, 0x00, 0x00, 0x00, 0x00, 0x00, 0x00, 0x00, 0x00, 0x00, 0x00, 0x00, 0x00, 0x00, 0x00, 0x00,
    0x00, 0x00, 0x00, 0x00, 0x00, 0x00, 0x00, 0x00, 0x00, 0x00, 0x00, 0x00, 0x00, 0x00, 0x00, 0x00,
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    0x00, 0x00, 0x00, 0x00, 0x00, 0x00, 0x00, 0x00, 0x00, 0x00, 0x00, 0x00, 0x00, 0x00, 0x00, 0x00};

class AppWoodenfish : public AppBase
{
private:
public:
    AppWoodenfish()
    {
        name = "Woodenfish";
        title = "电子木鱼";
        description = "电子木鱼";
        image = AppWoodenfish_icon;
        wakeupIO[0] = PIN_BUTTONL;
        wakeupIO[1] = PIN_BUTTONR;
        _showInList = true;
        noDefaultEvent = true;
    }
    void setup();
};
static AppWoodenfish app;
extern const char *dayOfWeek[];
void AppWoodenfish::setup()
{
    bool WfAuto = hal.pref.getBool("wfauto", 0);
    bool WfBuz = hal.pref.getBool("wfbuz", 0);
    display.refresh();
    u8g2Fonts.setFontMode(1);
    u8g2Fonts.setForegroundColor(0);
    u8g2Fonts.setBackgroundColor(1);

    if (hal.btnr.isPressing() || hal.btnl.isPressing())
    {
        Serial.println("左/右键按下");
        display.drawXBitmap(88, 24, WoodenfishNull, 120, 80, 0);
        display.drawXBitmap(88, 24, Woodenfish2, 120, 80, 0);
        u8g2Fonts.setCursor(180, 35);
        u8g2Fonts.printf("功德+1");
        display.display(true);
        if (WfBuz)
        {
            ledcSetup(0, 3000, 10);
            ledcAttachPin(PIN_BUZZER, 0);
            ledcWriteTone(0, 3000);
            ledcWrite(0, 20);
            delay(100);
            ledcWrite(0, 0);
            ledcWriteTone(0, 0);
            ledcDetachPin(PIN_BUZZER);
        }
        Serial.println("功德+1");
        delay(500);
    }
    else if (hal.btnc.isPressing())
    {
        if (GUI::waitLongPress(PIN_BUTTONC))
        {
            Serial.println("长按中键");

            const menu_item items[] = {
                {NULL, "返回"},
                {NULL, "自动模式设置"},
                {NULL, "敲击声音设置"},
                {NULL, "退出"},
                {NULL, NULL},
            };

            int ret = GUI::menu("电子木鱼设置", items);

            switch (ret)
            {
            case 0:
                break;
            case 1:
                if (GUI::msgbox_yn("自动模式设置", "请选择", "开启(右)", "关闭(左)"))
                {
                    WfAuto = true;
                    hal.pref.putBool("wfauto", 1);
                }
                else
                {
                    WfAuto = false;
                    hal.pref.putBool("wfauto", 0);
                }

                break;
            case 2:
                if (GUI::msgbox_yn("敲击声音设置", "请选择", "开启(右)", "关闭(左)"))
                {
                    WfBuz = true;
                    hal.pref.putBool("wfbuz", 1);
                }
                else
                {
                    WfBuz = false;
                    hal.pref.putBool("wfbuz", 0);
                }
                break;
            case 3:
            {
                appManager.goBack();
                return;
            }
            break;
            default:
                break;
            }
            display.display(true);
        }
    }
    if (WfAuto)
    {
        display.drawXBitmap(88, 24, WoodenfishNull, 120, 80, 0);
        display.drawXBitmap(88, 24, Woodenfish2, 120, 80, 0);
        u8g2Fonts.setCursor(180, 25);
        u8g2Fonts.printf("功德+1");
        display.display(true);
        Serial.println("功德+1");
        if (WfBuz)
        {
            ledcSetup(0, 3000, 10);
            ledcAttachPin(PIN_BUZZER, 0);
            ledcWriteTone(0, 3000);
            ledcWrite(0, 20);
            delay(100);
            ledcWrite(0, 0);
            ledcWriteTone(0, 0);
            ledcDetachPin(PIN_BUZZER);
        }
        delay(1000);
    }

    display.clearScreen();
    display.drawXBitmap(88, 24, Woodenfish1, 120, 80, 0);

    u8g2Fonts.setFont(u8g2_font_wqy12_t_gb2312);
    display.drawFastHLine(0, 108, 296, 0);
    u8g2Fonts.setCursor(5, 125);
    u8g2Fonts.printf("%02d月%02d日 星期%s", hal.timeinfo.tm_mon + 1, hal.timeinfo.tm_mday, dayOfWeek[hal.timeinfo.tm_wday]);

    if (peripherals.peripherals_current & PERIPHERALS_AHT20_BIT)
    {
        sensors_event_t humidity, temp;
        peripherals.load_append(PERIPHERALS_AHT20_BIT);
        xSemaphoreTake(peripherals.i2cMutex, portMAX_DELAY);
        peripherals.aht.getEvent(&humidity, &temp);
        xSemaphoreGive(peripherals.i2cMutex);
        u8g2Fonts.printf("Temp:%.1f℃ Humi:%.1f%%", temp.temperature, humidity.relative_humidity);
    }

    display.drawXBitmap(296 - 25 - 9, 115, getBatteryIcon(), 8, 12, 0);
    u8g2Fonts.setCursor(296 - 25, 125);
    if (hal.USBPluggedIn)
    {
        display.drawXBitmap(296 - 25 + 2, 116, getUSBIcon(), 22, 10, 0);
    }
    else
    {
        u8g2Fonts.printf("%d%%", getBatteryNum());
    }

    if (force_full_update || part_refresh_count > 20)
    {
        display.display(false);
        force_full_update = false;
        part_refresh_count = 0;
    }
    else
    {
        display.display(true);
        part_refresh_count++;
    }
    appManager.noDeepSleep = false;
    if (WfAuto)
    {
        appManager.nextWakeup = 5;
    }
    else
    {
        appManager.nextWakeup = 61 - hal.timeinfo.tm_sec;
    }
}
